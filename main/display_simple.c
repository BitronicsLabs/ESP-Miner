#include "display_simple.h"
#include "esp_log.h"
#include "esp_heap_caps.h"
#include <string.h>

static const char *TAG = "simple_display";

// Simple 6x8 ASCII font (printable characters 32-126)
// Each character is 6 bytes (6 pixels wide × 8 pixels tall, 1 byte per column)
static const uint8_t font_6x8[][6] = {
    {0x00, 0x00, 0x00, 0x00, 0x00, 0x00}, // 32 ' '
    {0x00, 0x00, 0x5F, 0x00, 0x00, 0x00}, // 33 '!'
    {0x00, 0x07, 0x00, 0x07, 0x00, 0x00}, // 34 '"'
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    {0x10, 0x08, 0x08, 0x10, 0x08, 0x00}, // 126 '~'
};

esp_err_t simple_display_init(simple_display_t *display, esp_lcd_panel_handle_t panel, uint16_t width, uint16_t height)
{
    if (!display || !panel) {
        return ESP_ERR_INVALID_ARG;
    }

    display->panel_handle = panel;
    display->width = width;
    display->height = height;

    // Allocate framebuffer (1 bit per pixel, organized in bytes)
    size_t fb_size = (width * height + 7) / 8;  // Round up to nearest byte
    display->framebuffer = heap_caps_calloc(fb_size, 1, MALLOC_CAP_INTERNAL | MALLOC_CAP_8BIT);

    if (!display->framebuffer) {
        ESP_LOGE(TAG, "Failed to allocate framebuffer (%d bytes)", fb_size);
        return ESP_ERR_NO_MEM;
    }

    display->initialized = true;
    ESP_LOGI(TAG, "Simple display initialized: %dx%d, framebuffer: %d bytes", width, height, fb_size);

    return ESP_OK;
}

void simple_display_clear(simple_display_t *display)
{
    if (!display || !display->initialized) {
        return;
    }

    size_t fb_size = (display->width * display->height + 7) / 8;
    memset(display->framebuffer, 0, fb_size);
}

void simple_display_set_pixel(simple_display_t *display, int x, int y, bool on)
{
    if (!display || !display->initialized) {
        return;
    }

    if (x < 0 || x >= display->width || y < 0 || y >= display->height) {
        return;
    }

    // Calculate byte position and bit position
    // For SSD1306: organized in pages (8 pixels vertical per page)
    int page = y / 8;
    int bit = y % 8;
    int index = page * display->width + x;

    if (on) {
        display->framebuffer[index] |= (1 << bit);
    } else {
        display->framebuffer[index] &= ~(1 << bit);
    }
}

void simple_display_draw_text(simple_display_t *display, const char *text, int x, int y)
{
    if (!display || !display->initialized || !text) {
        return;
    }

    int cursor_x = x;
    int cursor_y = y;

    while (*text) {
        char c = *text;

        // Only support printable ASCII
        if (c < 32 || c > 126) {
            if (c == '\n') {
                cursor_x = x;
                cursor_y += 8;  // Move to next line
                text++;
                continue;
            }
            c = '?';  // Replace unsupported characters
        }

        // Get font data
        const uint8_t *glyph = font_6x8[c - 32];

        // Draw character (6 pixels wide, 8 pixels tall)
        for (int col = 0; col < 6; col++) {
            uint8_t column_data = glyph[col];
            for (int row = 0; row < 8; row++) {
                if (column_data & (1 << row)) {
                    simple_display_set_pixel(display, cursor_x + col, cursor_y + row, true);
                }
            }
        }

        cursor_x += 6;  // Move to next character position

        // Wrap to next line if needed
        if (cursor_x + 6 > display->width) {
            cursor_x = x;
            cursor_y += 8;
        }

        text++;
    }
}

esp_err_t simple_display_update(simple_display_t *display)
{
    if (!display || !display->initialized) {
        return ESP_ERR_INVALID_STATE;
    }

    // Send framebuffer to display
    // For SSD1306/SSD1309/SH1107, the framebuffer format matches the display format
    esp_err_t ret = esp_lcd_panel_draw_bitmap(
        display->panel_handle,
        0, 0,
        display->width, display->height,
        display->framebuffer
    );

    if (ret != ESP_OK) {
        ESP_LOGE(TAG, "Failed to update display: %s", esp_err_to_name(ret));
    }

    return ret;
}

void simple_display_deinit(simple_display_t *display)
{
    if (!display) {
        return;
    }

    if (display->framebuffer) {
        free(display->framebuffer);
        display->framebuffer = NULL;
    }

    display->initialized = false;
    ESP_LOGI(TAG, "Simple display deinitialized");
}
